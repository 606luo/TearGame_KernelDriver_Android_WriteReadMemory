## DEV旧版驱动/内核驱动读写LINUX源码JiangNgihtDriverByTear/Kconfig
```kconfig
# ============================================================================
# ============================================================================
# ============================================================================
# 本项目完全免费开源，代码明文公开
# This project is completely free and open source with clear code
# 
# 禁止用于引流盈利，保留开源版权所有
# Commercial use for profit is prohibited, all open source rights reserved
# 
# 凡是恶意盈利者需承担法律责任
# Those who maliciously profit will bear legal responsibility
# ============================================================================

config KERNEL_HACK
	tristate "Kernel Hack Driver"
	default y
	help
	This is the kernel hack driver for android system.
```
